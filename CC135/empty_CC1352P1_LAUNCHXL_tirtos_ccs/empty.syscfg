/**
 * @cliArgs --board "/ti/boards/CC1352P1_LAUNCHXL" --product "simplelink_cc13x2_26x2_sdk@4.40.04.04"
 * @versions {"data":"2021010520","timestamp":"2021010520","tool":"1.7.0+1746","templates":null}
 */

/**
 * Import the modules used in this configuration.
 */
const Display  = scripting.addModule("/ti/display/Display", {}, false);
const Display1 = Display.addInstance();
const GPIO     = scripting.addModule("/ti/drivers/GPIO");
const GPIO1    = GPIO.addInstance();
const GPIO2    = GPIO.addInstance();
const GPIO3    = GPIO.addInstance();
const GPIO4    = GPIO.addInstance();
const RTOS     = scripting.addModule("/ti/drivers/RTOS");
const Timer    = scripting.addModule("/ti/drivers/Timer", {}, false);
const Timer1   = Timer.addInstance();
const Timer2   = Timer.addInstance();

/**
 * Write custom configuration values to the imported modules.
 */
Display1.$name                    = "CONFIG_Display_0";
Display1.$hardware                = system.deviceData.board.components.XDS110UART;
Display1.uart.$name               = "CONFIG_UART_0";
Display1.uart.txPinInstance.$name = "CONFIG_PIN_1";
Display1.uart.rxPinInstance.$name = "CONFIG_PIN_2";

GPIO1.$hardware         = system.deviceData.board.components.LED_RED;
GPIO1.$name             = "GPIO_LED_RED";
GPIO1.pull              = "Pull Down";
GPIO1.pinInstance.$name = "CONFIG_PIN_0";

GPIO2.mode               = "Output";
GPIO2.$name              = "GPIO_TX";
GPIO2.initialOutputState = "High";
GPIO2.pull               = "Pull Up";
GPIO2.gpioPin.$assign    = "boosterpack.6";
GPIO2.pinInstance.$name  = "CONFIG_PIN_3";
GPIO2.pinInstance.invert = true;

GPIO3.pull              = "Pull Down";
GPIO3.interruptTrigger  = "Rising Edge";
GPIO3.$name             = "GPIO_RX";
GPIO3.gpioPin.$assign   = "boosterpack.5";
GPIO3.pinInstance.$name = "CONFIG_PIN_4";

GPIO4.$hardware         = system.deviceData.board.components.LED_GREEN;
GPIO4.$name             = "GPIO_LED_Green";
GPIO4.pull              = "Pull Down";
GPIO4.pinInstance.$name = "CONFIG_PIN_5";

const CCFG              = scripting.addModule("/ti/devices/CCFG", {}, false);
CCFG.ccfgTemplate.$name = "ti_devices_CCFGTemplate0";

Timer1.$name               = "TIMER_0";
Timer1.timerInstance.$name = "CONFIG_GPTIMER_0";

Timer2.$name               = "TIMER_1";
Timer2.timerInstance.$name = "CONFIG_GPTIMER_1";

/**
 * Pinmux solution for unlocked pins/peripherals. This ensures that minor changes to the automatic solver in a future
 * version of the tool will not impact the pinmux you originally saw.  These lines can be completely deleted in order to
 * re-solve from scratch.
 */
Display1.uart.uart.$suggestSolution         = "UART1";
Display1.uart.uart.txPin.$suggestSolution   = "boosterpack.4";
Display1.uart.uart.rxPin.$suggestSolution   = "boosterpack.3";
GPIO1.gpioPin.$suggestSolution              = "boosterpack.39";
GPIO4.gpioPin.$suggestSolution              = "boosterpack.40";
Timer1.timerInstance.timer.$suggestSolution = "GPTM0";
Timer2.timerInstance.timer.$suggestSolution = "GPTM0";
